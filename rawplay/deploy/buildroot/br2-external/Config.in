## rawplay/deploy/buildroot/br2-external/Config.in
```kconfig
menu "LIVI appliance packages"

source "$BR2_EXTERNAL_LIVI_APPLIANCE_PATH/package/livi-lite/Config.in"
source "$BR2_EXTERNAL_LIVI_APPLIANCE_PATH/package/livi-appliance/Config.in"
source "$BR2_EXTERNAL_LIVI_APPLIANCE_PATH/package/rawlink/Config.in"
source "$BR2_EXTERNAL_LIVI_APPLIANCE_PATH/package/weston-touch/Config.in"
source "$BR2_EXTERNAL_LIVI_APPLIANCE_PATH/package/unit-sim/Config.in"
source "$BR2_EXTERNAL_LIVI_APPLIANCE_PATH/package/uwe5622/Config.in"

endmenu
```

## rawplay/deploy/buildroot/br2-external/package/livi-appliance/Config.in
```kconfig
config BR2_PACKAGE_LIVI_APPLIANCE
    bool "LIVI appliance services"
    depends on BR2_aarch64
    depends on BR2_INIT_SYSTEMD
    depends on BR2_USE_MMU
    depends on BR2_TOOLCHAIN_HAS_THREADS
    depends on BR2_TOOLCHAIN_USES_GLIBC
    select BR2_PACKAGE_LIVI_LITE
    select BR2_PACKAGE_RAWLINK
    select BR2_PACKAGE_WESTON_TOUCH
    select BR2_PACKAGE_WESTON
    select BR2_PACKAGE_WESTON_HEADLESS
    select BR2_PACKAGE_WESTON_SHELL_KIOSK
    select BR2_PACKAGE_BASH
    select BR2_PACKAGE_BLUEZ5_UTILS
    # bluetoothctl: livi-core's package probe looks for it; the helper itself
    # talks to BlueZ over D-Bus.
    select BR2_PACKAGE_BLUEZ5_UTILS_CLIENT
    select BR2_PACKAGE_DBUS
    # avahi: the helper publishes and browses CarPlay's mDNS records through
    # avahi-publish-service/avahi-browse, which need the daemon running.
    select BR2_PACKAGE_AVAHI
    select BR2_PACKAGE_AVAHI_DAEMON
    select BR2_PACKAGE_HOSTAPD
    select BR2_PACKAGE_DNSMASQ
    select BR2_PACKAGE_IW
    select BR2_PACKAGE_WIRELESS_REGDB
    select BR2_PACKAGE_IPROUTE2
    select BR2_PACKAGE_UTIL_LINUX
    select BR2_PACKAGE_UTIL_LINUX_RFKILL
    select BR2_PACKAGE_ALSA_UTILS
    select BR2_PACKAGE_ALSA_UTILS_APLAY
    select BR2_PACKAGE_PULSEAUDIO
    select BR2_PACKAGE_PULSEAUDIO_DAEMON
    select BR2_PACKAGE_HOST_MTOOLS
    select BR2_PACKAGE_HOST_DOSFSTOOLS
    select BR2_PACKAGE_HOST_E2FSPROGS
    select BR2_PACKAGE_HOST_GENIMAGE
    help
      The systemd units, helper shims and first-boot state handling that turn
      the rawlink/weston/LIVI packages into the appliance: gadget-first boot
      order, a read-only rootfs with a small persistent /data partition,
      PulseAudio with a null-sink fallback, and the tiny sudo/nmcli shims the
      bundled python helper expects on a system without NetworkManager.

if BR2_PACKAGE_LIVI_APPLIANCE

config BR2_PACKAGE_LIVI_APPLIANCE_DEBUG
    bool "debug image (serial console, initcall_debug, dropbear)"
    help
      The release image has no serial console and no login. The debug image
      keeps the UART, boots with initcall_debug and loglevel=7 (which
      scripts/boottime.sh parses), adds dropbear, and leaves kernel tracing
      enabled. It is measurably slower; never ship it.

config BR2_PACKAGE_LIVI_APPLIANCE_GPU
    bool "H616 GPU and video engine (panfrost + cedrus)"
    help
      Load the board's accelerator modules at boot: on the Orange Pi Zero
      2W that is the H616 video engine (sunxi-cedrus) and the Mali-G31
      (panfrost), whose device tree nodes and power domains come from the
      board kernel-patches backports. The weston session then picks the GL
      renderer, livi-compositor's EGL binds the GPU and a hardware-decoded
      frame reaches it as a dmabuf without a copy.

      With the GPU, GStreamer has the v4l2 stateless decoders
      (v4l2slh264dec/v4l2slh265dec via gst1-plugins-bad) and LIVI decodes
      the phone's H.264/HEVC in hardware; Mesa panfrost (plus the
      OpenCL/CLC precompiler it requires) is enabled in the board
      defconfigs. Without a render node LIVI falls back to converting the
      decoder's frames to system memory for the software sink.

      The qemu image has neither device and leaves this off.

endif
```

## rawplay/deploy/buildroot/br2-external/package/livi-lite/Config.in
```kconfig
config BR2_PACKAGE_LIVI_LITE
	bool "LIVI-Lite (native CarPlay/Android Auto head unit)"
	depends on BR2_aarch64
	depends on BR2_USE_MMU
	depends on BR2_TOOLCHAIN_HAS_THREADS
	depends on BR2_TOOLCHAIN_USES_GLIBC
	depends on BR2_PACKAGE_HOST_RUSTC_TARGET_ARCH_SUPPORTS
	depends on BR2_PACKAGE_HAS_LIBUDEV
	select BR2_PACKAGE_HOST_RUSTC
	select BR2_PACKAGE_WAYLAND
	select BR2_PACKAGE_LIBXKBCOMMON
	select BR2_PACKAGE_GSTREAMER1
	select BR2_PACKAGE_GST1_PLUGINS_BASE
	select BR2_PACKAGE_GST1_PLUGINS_BASE_PLUGIN_OPUS
	select BR2_PACKAGE_GST1_PLUGINS_GOOD
	select BR2_PACKAGE_GST1_PLUGINS_GOOD_PLUGIN_AUDIOFX
	select BR2_PACKAGE_GST1_PLUGINS_GOOD_PLUGIN_AUDIOPARSERS
	select BR2_PACKAGE_GST1_PLUGINS_GOOD_PLUGIN_PULSE
	select BR2_PACKAGE_GST1_PLUGINS_GOOD_PLUGIN_RTP
	select BR2_PACKAGE_GST1_PLUGINS_BAD
	select BR2_PACKAGE_GST1_PLUGINS_BAD_PLUGIN_FAAD
	select BR2_PACKAGE_GST1_PLUGINS_BAD_PLUGIN_VIDEOPARSERS
	select BR2_PACKAGE_GST1_PLUGINS_BAD_PLUGIN_WAYLAND
	select BR2_PACKAGE_GST1_LIBAV
	select BR2_PACKAGE_DEJAVU
	help
	  LIVI-Lite is the Electron-free fork of LIVI: the upstream Rust
	  core (livi-core, livi-helperd, the GStreamer video host) plus a
	  Slint UI and the Rust nested compositor, built from source against
	  the image's own GStreamer/Wayland. There is no AppImage, no
	  Electron/Chromium and no Ubuntu chroot: the four binaries start in
	  milliseconds, which is what makes the appliance boot fast.

	  DejaVu is selected because the GStreamer host's text rendering
	  (fontique/fontconfig) unwraps a font match and panics when the
	  image has no font installed at all.

	  The source tree is expected next to the ICC2-jailbreak checkout
	  (pukikiko/LIVI-Lite); override LIVI_LITE_SRC to point elsewhere.

	  https://github.com/pukikiko/LIVI-Lite

comment "livi-lite needs a glibc aarch64 toolchain with Rust support"
	depends on BR2_aarch64 && !BR2_TOOLCHAIN_USES_GLIBC
```

## rawplay/deploy/buildroot/br2-external/package/livi/Config.in
```kconfig
config BR2_PACKAGE_LIVI
    bool "LIVI (CarPlay/Android Auto head unit)"
    depends on BR2_aarch64
    depends on BR2_USE_MMU
    depends on BR2_TOOLCHAIN_HAS_THREADS
    depends on BR2_TOOLCHAIN_USES_GLIBC
    select BR2_PACKAGE_GSTREAMER1
    select BR2_PACKAGE_GST1_PLUGINS_BASE
    help
      LIVI 8.3.0 (aarch64 glibc Electron AppImage) plus the two shims the
      appliance needs: livi-stride-fix.so (the waylandsink stride fix) and
      the LIVI supervisor (the AppImage hands off to a detached compositor
      and exits, so a plain exec would look like a finished service).

      The AppImage is extracted at build time with host-squashfs: the
      aarch64 runtime cannot be run on the x86 build host, so the squashfs
      offset is computed from the ELF section headers (extract-appimage.py).

      Pinned to 8.3.0 on purpose: 9.x forces its inner app to Wayland and
      its GPU process hands dmabufs to the nested compositor, which the
      pixman renderer cannot import (Electron dies, panel black).
```

## rawplay/deploy/buildroot/br2-external/package/rawlink/Config.in
```kconfig
config BR2_PACKAGE_RAWLINK
    bool "rawlink"
    depends on BR2_USE_MMU
    depends on BR2_TOOLCHAIN_HAS_THREADS
    select BR2_PACKAGE_WAYLAND
    select BR2_PACKAGE_LIBUSB
    help
      rawlink, the host side of the raw livi link: the functionfs gadget
      (vendor video interface + mass storage) and the sender that captures
      the headless weston session over weston_capture_v1.

      Built from the checkout this br2-external tree lives in (the
      rawplay/ directory), so a git pull is all an update needs.

      https://github.com/f-anomaly/ICC2-jailbreak (rawplay/rawlink.c)
```

## rawplay/deploy/buildroot/br2-external/package/unit-sim/Config.in
```kconfig
config BR2_PACKAGE_UNIT_SIM
    bool "unit-sim (guest-side rawplay stand-in)"
    depends on BR2_USE_MMU
    depends on BR2_TOOLCHAIN_HAS_THREADS
    select BR2_PACKAGE_LIBUSB
    help
      unit-sim plays the car's rawplay on the wire inside a qemu guest: it
      enumerates the dummy_hcd gadget, validates LR MODE/FRAME messages,
      acks frames, sends the 1 s ready heartbeat, checks the mass-storage
      LUN mounts read-only, and records the T5/T6 boot milestones.

      It is a test instrument; leave it out of a release image.
```

## rawplay/deploy/buildroot/br2-external/package/uwe5622/Config.in
```kconfig
config BR2_PACKAGE_UWE5622
	bool "UWE5622 Wi-Fi/BT driver (out-of-tree modules)"
	depends on BR2_LINUX_KERNEL
	help
	  Unisoc/Spreadtrum UWE5622 (AW859A) Wi-Fi + Bluetooth combo on the
	  Orange Pi Zero 2W. Mainline Linux has no driver for it, so this
	  builds armbian/uwe5622 (pinned below) out of tree against the
	  image's own 6.12 kernel: uwe5622_bsp_sdio (SDIO core, Allwinner
	  board profile), sprdwl_ng (cfg80211 Wi-Fi: station + AP for the
	  helper's hostapd path) and sprdbt_tty (Bluetooth over SDIO,
	  attached to BlueZ by uwe5622-bluetooth.service). The firmware
	  (wcnmodem.bin, decoded from the driver's own .hex) ships in
	  /lib/firmware; the SDIO bus itself is enabled by the
	  uwe5622-overlay.dtbo applied in boot.cmd. Board images only:
	  qemu keeps its hwsim radios.
```

## rawplay/deploy/buildroot/br2-external/package/weston-touch/Config.in
```kconfig
config BR2_PACKAGE_WESTON_TOUCH
    bool "weston-touch module"
    depends on BR2_USE_MMU
    depends on BR2_TOOLCHAIN_HAS_THREADS
    select BR2_PACKAGE_WESTON
    select BR2_PACKAGE_WAYLAND
    help
      weston-touch.so, the weston module that adds a touch device and a key
      injector to the compositor's seat. rawlink drives it over a unix socket
      so touch and the panel keys reach the app as real wayland input.

      The module is compiled with -DLIVI_WESTON_MAJOR matching the weston
      package, because weston 16 changed the touch and keyboard APIs.
```
